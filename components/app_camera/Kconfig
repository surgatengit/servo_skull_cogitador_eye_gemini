## components/app_camera/Kconfig
```kconfig
menu "Cogitador M-01 camera (on-demand stills)"

    config VOX_CAMERA
        bool "Let Gemini take a picture on request (capturar_imagen)"
        default y
        help
            Declare the capturar_imagen function in the Live setup. When Gemini
            calls it, Cogitador opens the left-slot camera, takes one still, closes
            the camera and sends the JPEG as realtimeInput video. No video
            stream, nothing stored. Without a camera module the function
            answers that the camera is unavailable.

    if VOX_CAMERA

    config VOX_CAMERA_WIDTH
        int "Still width after rotation (pixels, multiple of 16)"
        range 64 640
        default 240

    config VOX_CAMERA_HEIGHT
        int "Still height after rotation (pixels, multiple of 16)"
        range 64 640
        default 320

    choice VOX_CAMERA_ROTATION
        prompt "Rotation applied by the PPA"
        default VOX_CAMERA_ROTATE_270
        help
            The module sits rotated on the board; 270 degrees plus a vertical
            mirror matches the BSP camera_photo_app preview. Adjust if Gemini
            describes the scene upside down or sideways.
        config VOX_CAMERA_ROTATE_0
            bool "0"
        config VOX_CAMERA_ROTATE_90
            bool "90"
        config VOX_CAMERA_ROTATE_180
            bool "180"
        config VOX_CAMERA_ROTATE_270
            bool "270"
    endchoice

    config VOX_CAMERA_MIRROR_X
        bool "Mirror horizontally"
        default n

    config VOX_CAMERA_MIRROR_Y
        bool "Mirror vertically"
        default y

    config VOX_CAMERA_SETTLE_FRAMES
        int "Frames discarded before the still (auto exposure)"
        range 0 30
        default 8

    config VOX_CAMERA_SENSOR_RESET
        bool "Reset the sensor before every still"
        default y
        help
            The camera board is not power-cycled by a software restart, and
            esp_video never resets the sensor. Without this the SC101IOT gives
            no frames after `iris restart` until the board is switched off.
            Pulses CAM_RESET (GPIO53, active low), sends
            ESP_CAM_SENSOR_IOC_SW_RESET and writes the format again.

    config VOX_CAMERA_BOOT_TEST
        bool "Diagnostic: take one test still 8 s after boot (not sent)"
        default n
        help
            Checks the camera without a conversation: one still is taken while
            Cogitador is idle and only logged (result and JPEG size). Used to find
            the USB Serial/JTAG conflict in test 12; off in normal builds.

    config VOX_CAMERA_JPEG_MAX_KB
        int "Largest JPEG sent to Gemini (KiB)"
        range 4 48
        default 24
        help
            Quality steps down (80, 65, 50, 35, 20) until the still fits.
            Base64 makes the WebSocket message about 4/3 of this size.

    endif

endmenu
```

## components/app_cogitador_session/Kconfig
```kconfig
menu "Cogitador M-01 Gemini Direct"

    config COGITADOR_GEMINI_MODEL
        string "Primary Gemini Live model"
        default "gemini-3.1-flash-live-preview"
        help
            Model used for new conversations. A provisioned override
            (RPC set_model) takes precedence without recompiling.
            gemini-3.8-live accepted setup but never transcribed or answered
            over a raw WebSocket in the 2026-11-24 hardware tests.

    config COGITADOR_GEMINI_FALLBACK_MODEL
        string "Fallback Gemini Live model"
        default "gemini-3.8-live"
        help
            Used after repeated setup failures, or once per boot when the
            active model stays silent while the user speaks.

    config COGITADOR_SILENT_MODEL_VOICED_FRAMES
        int "Voiced 40 ms frames without transcription before swapping model"
        range 25 1000
        default 250
        help
            Watchdog for a model that completes setup but never answers: after
            this many loud uplink frames (default 10 s of speech) with no input
            transcription on the connection, reconnect with the other model.

    config COGITADOR_VOICED_PEAK_THRESHOLD
        int "Uplink frame peak counted as voiced (0..32767)"
        range 100 32767
        default 1036
        help
            1036 is about -30 dBFS; the room noise floor measured about -42 dBFS.

    config COGITADOR_GEMINI_VOICE
        string "Prebuilt voice"
        default "Charon"

    config COGITADOR_GEMINI_LANGUAGE
        string "Speech language (BCP-47)"
        default "es-ES"

    config COGITADOR_WAKE_WORD
        bool "Wake on \"Hola ESP\" (local WakeNet10, wn10_es_holaesp)"
        default y
        help
            Listen locally for "Hola ESP" while the conversation is closed. No
            WebSocket is open and no audio leaves the device while idle. Needs the
            "model" partition with the esp-sr model image; without it Cogitador keeps
            working with touch only.

    config COGITADOR_ROLE_PHONE_PAGE
        bool "Phone page for private secrets in role mode"
        default y
        help
            While role mode is on, a small web page on port 80 of the home
            Wi-Fi lets each player register by name and read only their own
            secrets. Without it, secrets use the on-screen card.

    config COGITADOR_ROLE_IDLE_TIMEOUT_S
        int "Seconds without activity before returning to idle in role mode"
        range 30 900
        default 180
        help
            Role-play players think, roll and talk among themselves: the
            conversation waits longer before closing while modo_rol is on.

    config COGITADOR_IDLE_TIMEOUT_S
        int "Seconds without activity before returning to idle"
        range 10 600
        default 15
        help
            While listening, close the conversation after this time with no local
            voice (uplink frames above COGITADOR_VOICED_PEAK_THRESHOLD), user
            transcription, model output, turn or tap. Counted from the end of
            Cogitador's speech. Suspended while a reply is pending (see
            COGITADOR_RESPONSE_TIMEOUT_S).

    config COGITADOR_GOOGLE_SEARCH
        bool "Grounding with Google Search (native Live API tool)"
        default n
        help
            Optional, OFF by default (owner's decision, 2026-11-25): in test 10
            every setup declaring googleSearch was closed with code 1011 because
            the free-tier quota was exceeded on both models, and Cogitador could not
            connect. Enable only with quota available.

            Declare the googleSearch tool in the Live setup message so Gemini can
            search the web by itself (server side, no intermediate service). Each
            search may be billed separately: see docs/GOOGLE_SEARCH.md.

    config COGITADOR_SHOW_SEARCH_SOURCES
        bool "Show Google search suggestions and sources on the status line"
        depends on COGITADOR_GOOGLE_SEARCH
        default n
        help
            Off by default at the owner's request: Cogitador searches quietly and never
            cites sources. When on, the status line rotates "GOOGLE: <query>" and
            "FUENTE n/m: <domain>" (see docs/GOOGLE_SEARCH.md section 4).

    config COGITADOR_RESPONSE_TIMEOUT_S
        int "Seconds to wait for Gemini to finish a turn (search, thinking)"
        range 10 120
        default 30
        help
            After the user's turn, and while the model's turn is open (no
            turnComplete yet), the idle timeout is suspended and the eye stays
            amber until this many seconds pass without any server output.
            Protects searches and reasoning pauses from the idle return.

    config COGITADOR_PREROLL_MS
        int "Audio kept after the wake word while connecting (ms)"
        range 400 4000
        default 2000
        help
            Frames captured between "Hola ESP" and setupComplete are sent first so
            the question spoken right after the wake word is not lost.

    config COGITADOR_SPEAKER_VOLUME
        int "Speaker volume (0-100)"
        range 1 100
        default 70

    config COGITADOR_MIC_GAIN_DB
        int "Microphone gain (dB)"
        range 0 42
        default 24
        help
            30 dB saturated (0 dBFS peaks) with normal speech at 20-30 cm and
            with speaker echo in the first hardware tests.

endmenu
```

## components/app_photos/Kconfig
```kconfig
menu "Cogitador M-01 photo store"

    config COGITADOR_PHOTOS_SLOTS
        int "Stills kept in the photos partition (oldest replaced)"
        range 1 10
        default 10
        help
            Each slot is 48 KiB in the 512 KiB "photos" partition, so at most 10.
            The gallery on the eye screen shows them, newest first.

endmenu
```

## components/app_vox_session/Kconfig
```kconfig
menu "VOX M-01 Gemini Direct"

    config VOX_GEMINI_MODEL
        string "Primary Gemini Live model"
        default "gemini-3.1-flash-live-preview"
        help
            Model used for new conversations. A provisioned override
            (RPC set_model) takes precedence without recompiling.
            gemini-3.8-live accepted setup but never transcribed or answered
            over a raw WebSocket in the 2026-11-24 hardware tests.

    config VOX_GEMINI_FALLBACK_MODEL
        string "Fallback Gemini Live model"
        default "gemini-3.8-live"
        help
            Used after repeated setup failures, or once per boot when the
            active model stays silent while the user speaks.

    config VOX_SILENT_MODEL_VOICED_FRAMES
        int "Voiced 40 ms frames without transcription before swapping model"
        range 25 1000
        default 250
        help
            Watchdog for a model that completes setup but never answers: after
            this many loud uplink frames (default 10 s of speech) with no input
            transcription on the connection, reconnect with the other model.

    config VOX_VOICED_PEAK_THRESHOLD
        int "Uplink frame peak counted as voiced (0..32767)"
        range 100 32767
        default 1036
        help
            1036 is about -30 dBFS; the room noise floor measured about -42 dBFS.

    config VOX_GEMINI_VOICE
        string "Prebuilt voice"
        default "Charon"

    config VOX_GEMINI_LANGUAGE
        string "Speech language (BCP-47)"
        default "es-ES"

    config VOX_WAKE_WORD
        bool "Wake on \"Hola ESP\" (local WakeNet10, wn10_es_holaesp)"
        default y
        help
            Listen locally for "Hola ESP" while the conversation is closed. No
            WebSocket is open and no audio leaves the device while idle. Needs the
            "model" partition with the esp-sr model image; without it VOX keeps
            working with touch only.

    config VOX_IDLE_TIMEOUT_S
        int "Seconds without activity before returning to idle"
        range 10 600
        default 15
        help
            While listening, close the conversation after this time with no local
            voice (uplink frames above VOX_VOICED_PEAK_THRESHOLD), user
            transcription, model output, turn or tap. Counted from the end of
            VOX's speech. Suspended while a reply is pending (see
            VOX_RESPONSE_TIMEOUT_S).

    config VOX_GOOGLE_SEARCH
        bool "Grounding with Google Search (native Live API tool)"
        default n
        help
            Optional, OFF by default (owner's decision, 2026-11-25): in test 10
            every setup declaring googleSearch was closed with code 1011 because
            the free-tier quota was exceeded on both models, and VOX could not
            connect. Enable only with quota available.

            Declare the googleSearch tool in the Live setup message so Gemini can
            search the web by itself (server side, no intermediate service). Each
            search may be billed separately: see docs/GOOGLE_SEARCH.md.

    config VOX_SHOW_SEARCH_SOURCES
        bool "Show Google search suggestions and sources on the status line"
        depends on VOX_GOOGLE_SEARCH
        default n
        help
            Off by default at the owner's request: VOX searches quietly and never
            cites sources. When on, the status line rotates "GOOGLE: <query>" and
            "FUENTE n/m: <domain>" (see docs/GOOGLE_SEARCH.md section 4).

    config VOX_RESPONSE_TIMEOUT_S
        int "Seconds to wait for Gemini to finish a turn (search, thinking)"
        range 10 120
        default 30
        help
            After the user's turn, and while the model's turn is open (no
            turnComplete yet), the idle timeout is suspended and the eye stays
            amber until this many seconds pass without any server output.
            Protects searches and reasoning pauses from the idle return.

    config VOX_PREROLL_MS
        int "Audio kept after the wake word while connecting (ms)"
        range 400 4000
        default 2000
        help
            Frames captured between "Hola ESP" and setupComplete are sent first so
            the question spoken right after the wake word is not lost.

    config VOX_SPEAKER_VOLUME
        int "Speaker volume (0-100)"
        range 1 100
        default 70

    config VOX_MIC_GAIN_DB
        int "Microphone gain (dB)"
        range 0 42
        default 24
        help
            30 dB saturated (0 dBFS peaks) with normal speech at 20-30 cm and
            with speaker echo in the first hardware tests.

endmenu
```
